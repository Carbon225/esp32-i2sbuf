## Kconfig
```kconfig
menu "I2SBUF"
    config I2SBUF_TASK_STACK_SIZE
        int "Sample generator/writer task stack size"
        default 4096
        
    config I2SBUF_TASK_PRIORITY
        int "Sample generator/writer task priority"
        default 10 
endmenu
```
